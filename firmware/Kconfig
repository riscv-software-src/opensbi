## firmware/Kconfig
```kconfig
# SPDX-License-Identifier: BSD-2-Clause

menu "Stack Protector Support"

config STACK_PROTECTOR
	bool "Stack Protector buffer overflow detection"
	default n
	help
	  This option turns on the "stack-protector" compiler feature.

config STACK_PROTECTOR_STRONG
	bool "Strong Stack Protector"
	depends on STACK_PROTECTOR
	default n
	help
	  Turn on the "stack-protector" with "-fstack-protector-strong" option.
	  Like -fstack-protector but includes additional functions to be
	  protected.

config STACK_PROTECTOR_ALL
	bool "Almighty Stack Protector"
	depends on STACK_PROTECTOR
	default n
	help
	  Turn on the "stack-protector" with "-fstack-protector-all" option.
	  Like -fstack-protector except that all functions are protected.

endmenu
```

## lib/sbi/Kconfig
```kconfig
# SPDX-License-Identifier: BSD-2-Clause

menu "Generic SBI Support"

config CONSOLE_EARLY_BUFFER_SIZE
	int "Early console buffer size (bytes)"
	default 256

config ZKR_POLL_BUDGET
	int "Zkr seed polling budget (iterations)"
	default 1000
	help
	  Maximum number of iterations to poll CSR_SEED when initializing
	  the stack guard variable. The Zkr specification doesn't define
	  a time limit on transitioning to ES16 between polls, which
	  makes it impossible to tell whether entropy is being
	  accumulated slowly or the entropy source is not functioning.
	  This also limits the wait time on systems with an event-driven
	  entropy source. A successful read doesn't consume a try.

config SBI_ECALL_TIME
	bool "Timer extension"
	default y

config SBI_ECALL_RFENCE
	bool "RFENCE extension"
	default y

config SBI_ECALL_IPI
	bool "IPI extension"
	default y

config SBI_ECALL_HSM
	bool "Hart State Management extension"
	default y

config SBI_ECALL_SRST
	bool "System Reset extension"
	default y

config SBI_ECALL_SUSP
	bool "System Suspend extension"
	default y

config SBI_ECALL_PMU
	bool "Performance Monitoring Unit extension"
	default y

config SBI_ECALL_DBCN
	bool "Debug Console extension"
	default y

config SBI_ECALL_CPPC
	bool "CPPC extension"
	default y

config SBI_ECALL_FWFT
	bool "Firmware Feature extension"
	default y

config SBI_ECALL_LEGACY
	bool "SBI v0.1 legacy extensions"
	default y

config SBI_ECALL_VENDOR
	bool "Platform-defined vendor extensions"
	default y

config SBI_ECALL_DBTR
	bool "Debug Trigger Extension"
	default y

config SBIUNIT
	bool "Enable SBIUNIT tests"
	default n

config SBI_ECALL_SSE
	bool "SSE extension"
	default y

config SBI_ECALL_MPXY
	bool "MPXY extension"
	default y
endmenu
```

## lib/utils/Kconfig
```kconfig
# SPDX-License-Identifier: BSD-2-Clause

menu "Utils and Drivers Support"

source "$(OPENSBI_SRC_DIR)/lib/utils/cache/Kconfig"

source "$(OPENSBI_SRC_DIR)/lib/utils/cppc/Kconfig"

source "$(OPENSBI_SRC_DIR)/lib/utils/fdt/Kconfig"

source "$(OPENSBI_SRC_DIR)/lib/utils/gpio/Kconfig"

source "$(OPENSBI_SRC_DIR)/lib/utils/hsm/Kconfig"

source "$(OPENSBI_SRC_DIR)/lib/utils/i2c/Kconfig"

source "$(OPENSBI_SRC_DIR)/lib/utils/ipi/Kconfig"

source "$(OPENSBI_SRC_DIR)/lib/utils/irqchip/Kconfig"

source "$(OPENSBI_SRC_DIR)/lib/utils/libfdt/Kconfig"

source "$(OPENSBI_SRC_DIR)/lib/utils/mailbox/Kconfig"

source "$(OPENSBI_SRC_DIR)/lib/utils/regmap/Kconfig"

source "$(OPENSBI_SRC_DIR)/lib/utils/reset/Kconfig"

source "$(OPENSBI_SRC_DIR)/lib/utils/serial/Kconfig"

source "$(OPENSBI_SRC_DIR)/lib/utils/suspend/Kconfig"

source "$(OPENSBI_SRC_DIR)/lib/utils/sys/Kconfig"

source "$(OPENSBI_SRC_DIR)/lib/utils/timer/Kconfig"

source "$(OPENSBI_SRC_DIR)/lib/utils/mpxy/Kconfig"

endmenu
```

## lib/utils/cache/Kconfig
```kconfig
# SPDX-License-Identifier: BSD-2-Clause

menu "Cache Support"

config FDT_CACHE
	bool "FDT based cache drivers"
	depends on FDT
	select CACHE
	default n

if FDT_CACHE

config FDT_CACHE_SIFIVE_CCACHE
	bool "SiFive CCACHE FDT cache driver"
	default n

config FDT_CACHE_SIFIVE_EC
	bool "SiFive EC FDT cache driver"
	default n

config FDT_CACHE_SIFIVE_PL2
	bool "SiFive PL2 FDT cache driver"
	default n

endif

config CACHE
	bool "Cache support"
	default n

endmenu
```

## lib/utils/cppc/Kconfig
```kconfig
# SPDX-License-Identifier: BSD-2-Clause

menu "CPPC Device Support"

config FDT_CPPC
	bool "FDT based CPPC drivers"
	depends on FDT
	default n

if FDT_CPPC

config FDT_CPPC_RPMI
	bool "FDT RPMI CPPC driver"
	depends on FDT_MAILBOX && RPMI_MAILBOX
	default n

endif

endmenu
```

## lib/utils/fdt/Kconfig
```kconfig
# SPDX-License-Identifier: BSD-2-Clause

menuconfig FDT
	bool "Flattened Device Tree (FDT) support"
	select LIBFDT
	default n

if FDT

config FDT_DOMAIN
	bool "FDT domain support"
	default n

config FDT_PMU
	bool "FDT performance monitoring unit (PMU) support"
	default n

config FDT_FIXUPS_PRESERVE_PMU_NODE
	bool "Preserve PMU node in device-tree"
	depends on FDT_PMU
	default n
	help
	  Preserve PMU node properties for debugging purposes.

endif
```

## lib/utils/gpio/Kconfig
```kconfig
# SPDX-License-Identifier: BSD-2-Clause

menu "GPIO Support"

config FDT_GPIO
	bool "FDT based GPIO drivers"
	depends on FDT
	select GPIO
	default n

if FDT_GPIO

config FDT_GPIO_DESIGNWARE
	bool "DesignWare GPIO driver"
	default n

config FDT_GPIO_SIFIVE
	bool "SiFive GPIO FDT driver"
	default n

config FDT_GPIO_STARFIVE
	bool "StarFive GPIO FDT driver"
	default n
endif

config GPIO
	bool "GPIO support"
	default n

endmenu
```

## lib/utils/hsm/Kconfig
```kconfig
# SPDX-License-Identifier: BSD-2-Clause

menu "HSM Device Support"

config FDT_HSM
	bool "FDT based HSM drivers"
	depends on FDT
	default n

if FDT_HSM

config FDT_HSM_RPMI
	bool "FDT RPMI HSM driver"
	depends on FDT_MAILBOX && RPMI_MAILBOX
	default n

config FDT_HSM_SIFIVE_TMC0
	bool "FDT SiFive TMC v0 driver"
	depends on FDT_CACHE
	default n

config FDT_HSM_SPACEMIT
	bool "FDT SPACEMIT HSM driver"
	default n

endif

endmenu
```

## lib/utils/i2c/Kconfig
```kconfig
# SPDX-License-Identifier: BSD-2-Clause

menu "I2C Support"

config FDT_I2C
	bool "FDT based I2C drivers"
	depends on FDT
	select I2C
	default n

if FDT_I2C

config FDT_I2C_SIFIVE
	bool "SiFive I2C FDT driver"
	default n

config FDT_I2C_DW
	bool "Synopsys Designware I2C FDT driver"
	select I2C_DW
	default n
endif

config I2C_DW
	bool "Synopsys Designware I2C support"
	default n

config I2C
	bool "I2C support"
	default n

endmenu
```

## lib/utils/ipi/Kconfig
```kconfig
# SPDX-License-Identifier: BSD-2-Clause

menu "IPI Device Support"

config FDT_IPI
	bool "FDT based ipi drivers"
	depends on FDT
	default n

if FDT_IPI

config FDT_IPI_MSWI
	bool "ACLINT MSWI FDT driver"
	select IPI_MSWI
	default n

endif

config IPI_MSWI
	bool "ACLINT MSWI support"
	default n

endmenu
```

## lib/utils/mailbox/Kconfig
```kconfig
# SPDX-License-Identifier: BSD-2-Clause

menu "Mailbox Support"

config FDT_MAILBOX
	bool "FDT based mailbox drivers"
	depends on FDT
	select MAILBOX
	default n

config RPMI_MAILBOX
	bool "RPMI based mailbox drivers"
	select MAILBOX
	default n

config MAILBOX
	bool "Mailbox support"
	default n

if FDT_MAILBOX

config FDT_MAILBOX_RPMI_SHMEM
	bool "RPMI Shared Memory Mailbox Controller"
	depends on RPMI_MAILBOX
	default n

endif

endmenu
```

## lib/utils/mpxy/Kconfig
```kconfig
# SPDX-License-Identifier: BSD-2-Clause

menu "MPXY Device Support"

config FDT_MPXY
	bool "FDT based MPXY drivers"
	depends on FDT
	default n

config FDT_MPXY_RPMI_MBOX
	bool "MPXY drivers as RPMI mailbox client"
	depends on FDT_MAILBOX && FDT_MPXY
	default n

if FDT_MPXY_RPMI_MBOX

config FDT_MPXY_RPMI_CLOCK
	bool "MPXY driver for RPMI clock service group"
	default n

config FDT_MPXY_RPMI_SYSMSI
	bool "MPXY driver for RPMI system MSI service group"
	default n

config FDT_MPXY_RPMI_VOLTAGE
	bool "MPXY driver for RPMI voltage service group"
	default n

config FDT_MPXY_RPMI_DEVICE_POWER
	bool "MPXY driver for RPMI device power service group"
	default n

config FDT_MPXY_RPMI_PERFORMANCE
	bool "MPXY driver for RPMI performance service group"
	default n

endif

endmenu
```

## lib/utils/regmap/Kconfig
```kconfig
# SPDX-License-Identifier: BSD-2-Clause

menu "Regmap Support"

config FDT_REGMAP
	bool "FDT based regmap drivers"
	depends on FDT
	select REGMAP
	default n

if FDT_REGMAP

config FDT_REGMAP_SYSCON
	bool "Syscon regmap FDT driver"
	default n
endif

config REGMAP
	bool "Regmap support"
	default n

endmenu
```

## lib/utils/reset/Kconfig
```kconfig
# SPDX-License-Identifier: BSD-2-Clause

menu "System Reset Support"

config FDT_RESET
	bool "FDT based reset drivers"
	depends on FDT
	default n

if FDT_RESET

config FDT_RESET_ATCWDT200
	bool "Andes WDT FDT reset driver"
	depends on SYS_ATCSMU
	default n

config FDT_RESET_GPIO
	bool "GPIO FDT reset driver"
	depends on FDT_GPIO
	default n

config FDT_RESET_HTIF
	bool "Host transfer interface (HTIF) FDT reset driver"
	select SYS_HTIF
	default n

config FDT_RESET_RPMI
	bool "RPMI FDT reset driver"
	depends on FDT_MAILBOX && RPMI_MAILBOX
	default n

config FDT_RESET_SG2042_HWMON_MCU
	bool "Sophgo SG2042 hwmon MCU FDT reset driver"
	default n

config FDT_RESET_SUNXI_WDT
	bool "Sunxi WDT FDT reset driver"
	default n

config FDT_RESET_SYSCON
	bool "Syscon FDT reset driver"
	depends on FDT_REGMAP
	default n

endif

endmenu
```

## lib/utils/suspend/Kconfig
```kconfig
# SPDX-License-Identifier: BSD-2-Clause

menu "System Suspend Support"

config FDT_SUSPEND
	bool "FDT based suspend drivers"
	depends on FDT
	default n

if FDT_SUSPEND

config FDT_SUSPEND_RPMI
	bool "FDT RPMI suspend driver"
	depends on FDT_MAILBOX && RPMI_MAILBOX
	default n

config FDT_SUSPEND_SIFIVE_SMC0
	bool "FDT SIFIVE SMC0 suspend driver"
	depends on FDT_HSM_SIFIVE_TMC0 && IRQCHIP_APLIC
	default n
endif

endmenu
```

## lib/utils/sys/Kconfig
```kconfig
# SPDX-License-Identifier: BSD-2-Clause

menu "System Device Support"

config SYS_HTIF
	bool "Host transfere interface (HTIF) support"
	default n

endmenu
```

## platform/andes/ae350/Kconfig
```kconfig
# SPDX-License-Identifier: BSD-2-Clause

config PLATFORM_ANDES_AE350
	bool
	select FDT
	select FDT_SERIAL
	select FDT_SERIAL_UART8250
	select FDT_TIMER
	select FDT_TIMER_PLMT
	select FDT_RESET
	select FDT_RESET_ATCWDT200
	select FDT_IRQCHIP
	select FDT_IRQCHIP_PLIC
	select FDT_IPI
	select FDT_IPI_PLICSW
	default y

if PLATFORM_ANDES_AE350

config PLATFORM_ANDES_AE350_NAME
	string "Platform default name"
	default "Andes AE350"

config PLATFORM_ANDES_AE350_MAJOR_VER
	int "Platform major version"
	range 0 65535
	default 0

config PLATFORM_ANDES_AE350_MINOR_VER
	int "Platform minor version"
	range 0 65535
	default 1

endif
```

## platform/fpga/ariane/Kconfig
```kconfig
# SPDX-License-Identifier: BSD-2-Clause

config PLATFORM_ARIANE_FPGA
	bool
	select IPI_MSWI
	select SERIAL_UART8250
	select TIMER_MTIMER
	default y
```

## platform/fpga/openpiton/Kconfig
```kconfig
# SPDX-License-Identifier: BSD-2-Clause

config PLATFORM_OPENPITON_FPGA
	bool
	select SERIAL_UART8250
	default y
```

## platform/generic/Kconfig
```kconfig
# SPDX-License-Identifier: BSD-2-Clause

config PLATFORM_GENERIC
	bool
	select FDT
	select FDT_DOMAIN
	select FDT_PMU
	default y

if PLATFORM_GENERIC

config PLATFORM_GENERIC_NAME
	string "Platform default name"
	default "Generic"

config PLATFORM_GENERIC_MAJOR_VER
	int "Platform major version"
	range 0 65535
	default 0

config PLATFORM_GENERIC_MINOR_VER
	int "Platform minor version"
	range 0 65535
	default 1

config PLATFORM_ALLWINNER_D1
	bool "Allwinner D1 support"
	depends on FDT_IRQCHIP_PLIC
	select THEAD_C9XX_PMU
	default n

config PLATFORM_ANDES_AE350
	bool "Andes AE350 support"
	select SYS_ATCSMU
	select ANDES_PMU
	select ANDES_PMA
	default n

config PLATFORM_ANDES_QILAI
	bool "Andes QiLai support"
	select ANDES_PMU
	select ANDES_PMA
	select ANDES_SBI
	default n

config PLATFORM_OPENHWGROUP_OPENPITON
	bool "OpenHWGroup Openpiton support"
	default n

config PLATFORM_OPENHWGROUP_ARIANE
	bool "OpenHWGroup Ariane support"
	default n

config PLATFORM_RENESAS_RZFIVE
	bool "Renesas RZ/Five support"
	select ANDES_PMA
	select ANDES_SBI
	select ANDES_PMU
	default n

config PLATFORM_SIFIVE_FU540
	bool "SiFive FU540 support"
	default n

config PLATFORM_SIFIVE_FU740
	bool "SiFive FU740 support"
	depends on FDT_RESET && FDT_I2C
	default n

config PLATFORM_SOPHGO_SG2042
	bool "Sophgo sg2042 support"
	select THEAD_C9XX_ERRATA
	select THEAD_C9XX_PMU
	default n

config PLATFORM_STARFIVE_JH7110
	bool "StarFive JH7110 support"
	default n

config PLATFORM_THEAD
	bool "THEAD C9xx support"
	select THEAD_C9XX_ERRATA
	select THEAD_C9XX_PMU
	default n

config PLATFORM_MIPS_P8700
	bool "MIPS P8700 support"
	default n

config PLATFORM_SPACEMIT_K1
	bool "Spacemit K1 support"
	select FDT_HSM_SPACEMIT
	default n

source "$(OPENSBI_SRC_DIR)/platform/generic/andes/Kconfig"
source "$(OPENSBI_SRC_DIR)/platform/generic/thead/Kconfig"

endif
```

## platform/generic/andes/Kconfig
```kconfig
# SPDX-License-Identifier: BSD-2-Clause

config ANDES_PMA
	bool "Andes PMA support"
	default n
	help
	  Programmable PMA(PPMA) is a feature for Andes. PPMA allows
	  dynamic adjustment of memory attributes in the runtime.
	  It contains a configurable amount of PMA entries implemented
	  as CSRs to control the attributes of memory locations in interest.

config ANDES_SBI
	bool "Andes SBI support"
	default n

config ANDES_PMU
	bool "Andes PMU extension (XAndesPMU) support"
	default n
	help
	  Andes PMU extension supports the event counter overflow
	  interrupt and mode filtering, similar to the standard
	  Sscofpmf and Smcntrpmf.
```

## platform/generic/configs/defconfig
```kconfig
CONFIG_PLATFORM_ALLWINNER_D1=y
CONFIG_PLATFORM_ANDES_AE350=y
CONFIG_PLATFORM_ANDES_QILAI=y
CONFIG_PLATFORM_OPENHWGROUP_ARIANE=y
CONFIG_PLATFORM_OPENHWGROUP_OPENPITON=y
CONFIG_PLATFORM_RENESAS_RZFIVE=y
CONFIG_PLATFORM_SIFIVE_FU540=y
CONFIG_PLATFORM_SIFIVE_FU740=y
CONFIG_PLATFORM_SOPHGO_SG2042=y
CONFIG_PLATFORM_STARFIVE_JH7110=y
CONFIG_PLATFORM_THEAD=y
CONFIG_PLATFORM_MIPS_P8700=y
CONFIG_PLATFORM_SPACEMIT_K1=y
CONFIG_FDT_CACHE=y
CONFIG_FDT_CACHE_SIFIVE_CCACHE=y
CONFIG_FDT_CACHE_SIFIVE_EC=y
CONFIG_FDT_CACHE_SIFIVE_PL2=y
CONFIG_FDT_CPPC=y
CONFIG_FDT_CPPC_RPMI=y
CONFIG_FDT_GPIO=y
CONFIG_FDT_GPIO_DESIGNWARE=y
CONFIG_FDT_GPIO_SIFIVE=y
CONFIG_FDT_GPIO_STARFIVE=y
CONFIG_FDT_HSM=y
CONFIG_FDT_HSM_RPMI=y
CONFIG_FDT_HSM_SIFIVE_TMC0=y
CONFIG_FDT_I2C=y
CONFIG_FDT_I2C_SIFIVE=y
CONFIG_FDT_I2C_DW=y
CONFIG_FDT_IPI=y
CONFIG_FDT_IPI_MSWI=y
CONFIG_FDT_IPI_PLICSW=y
CONFIG_FDT_IRQCHIP=y
CONFIG_FDT_IRQCHIP_APLIC=y
CONFIG_FDT_IRQCHIP_IMSIC=y
CONFIG_FDT_IRQCHIP_PLIC=y
CONFIG_FDT_MAILBOX=y
CONFIG_RPMI_MAILBOX=y
CONFIG_FDT_MAILBOX_RPMI_SHMEM=y
CONFIG_FDT_REGMAP=y
CONFIG_FDT_REGMAP_SYSCON=y
CONFIG_FDT_RESET=y
CONFIG_FDT_RESET_ATCWDT200=y
CONFIG_FDT_RESET_GPIO=y
CONFIG_FDT_RESET_HTIF=y
CONFIG_FDT_RESET_RPMI=y
CONFIG_FDT_RESET_SG2042_HWMON_MCU=y
CONFIG_FDT_RESET_SUNXI_WDT=y
CONFIG_FDT_RESET_SYSCON=y
CONFIG_FDT_SERIAL=y
CONFIG_FDT_SERIAL_CADENCE=y
CONFIG_FDT_SERIAL_GAISLER=y
CONFIG_FDT_SERIAL_HTIF=y
CONFIG_FDT_SERIAL_RENESAS_SCIF=y
CONFIG_FDT_SERIAL_SHAKTI=y
CONFIG_FDT_SERIAL_SIFIVE=y
CONFIG_FDT_SERIAL_LITEX=y
CONFIG_FDT_SERIAL_UART8250=y
CONFIG_FDT_SERIAL_XILINX_UARTLITE=y
CONFIG_SERIAL_SEMIHOSTING=y
CONFIG_FDT_SUSPEND=y
CONFIG_FDT_SUSPEND_RPMI=y
CONFIG_FDT_SUSPEND_SIFIVE_SMC0=y
CONFIG_FDT_TIMER=y
CONFIG_FDT_TIMER_MTIMER=y
CONFIG_FDT_TIMER_PLMT=y
CONFIG_FDT_MPXY=y
CONFIG_FDT_MPXY_RPMI_MBOX=y
CONFIG_FDT_MPXY_RPMI_CLOCK=y
CONFIG_FDT_MPXY_RPMI_VOLTAGE=y
CONFIG_FDT_MPXY_RPMI_DEVICE_POWER=y
CONFIG_FDT_MPXY_RPMI_PERFORMANCE=y
CONFIG_FDT_MPXY_RPMI_SYSMSI=y
```
