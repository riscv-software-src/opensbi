## platform/kendryte/k210/Kconfig
```kconfig
# SPDX-License-Identifier: BSD-2-Clause

config PLATFORM_KENDRYTE_K210
	bool
	select IPI_MSWI
	select SERIAL_SIFIVE
	select TIMER_MTIMER
	default y
```

## platform/nuclei/ux600/Kconfig
```kconfig
# SPDX-License-Identifier: BSD-2-Clause

config PLATFORM_NUCLEI_UX600
	bool
	select SERIAL_SIFIVE
	default y
```
